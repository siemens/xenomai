## ksrc/arch/powerpc/Config.in
```kconfig
mainmenu_option next_comment
comment 'Real-time sub-system'

bool 'Xenomai' CONFIG_XENOMAI

source kernel/xenomai/Config.in

if [ "$CONFIG_XENOMAI" = "y" -a "$CONFIG_XENO_OPT_NUCLEUS" != "n" ]; then
	mainmenu_option next_comment
	comment 'Machine'
	bool 'Enable FPU support' CONFIG_XENO_HW_FPU
	endmenu
fi

endmenu
```

## ksrc/arch/powerpc/Kconfig
```kconfig
config XENO_GENERIC_STACKPOOL
	bool
	default y

config XENO_FASTSYNCH
	bool
	default y

config XENO_HW_MATH_EMU
        bool
	default y if MATH_EMU || 8XX_MINIMAL_FPEMU

source "kernel/xenomai/nucleus/Kconfig"

menu "Machine"

depends on XENO_OPT_NUCLEUS

config IPIPE_WANT_ACTIVE_MM
        bool

config IPIPE_WANT_PREEMPTIBLE_SWITCH
        bool
	select IPIPE_WANT_ACTIVE_MM
	default y if XENO_HW_UNLOCKED_SWITCH
	default n if !XENO_HW_UNLOCKED_SWITCH

config XENO_HW_FPU
	bool "Enable FPU support"
	depends on PPC_FPU
	default y
	help
	The FPU executes instructions from the processor's normal
	instruction stream. It can handle the types of high-precision
	floating-point processing operations commonly found in
	scientific, engineering, and business applications.
	If your target system has no FPU, say NO here; otherwise,
	enabling FPU support when the hardware is available may
	greatly improve	performance.

config XENO_HW_UNLOCKED_SWITCH
	bool "Enable unlocked context switch"
	depends on IPIPE_HAVE_PREEMPTIBLE_SWITCH
	default y
	help

	The nucleus may allow non-atomic execution of the
	machine-dependent context switching code, so that other CPUs
	and/or local interrupts may execute concurrently.

	This option reduces interrupt latency when costly cache and
	TLB flushes are required to switch context, and may improve
	concurrency on some SMP/multi-core systems as well.

endmenu

source "kernel/xenomai/skins/Kconfig"
source "drivers/xenomai/Kconfig"
```

## ksrc/arch/sh/Kconfig
```kconfig
config XENO_GENERIC_STACKPOOL
	bool
	default y

source "kernel/xenomai/nucleus/Kconfig"

menu "Machine"

depends on XENO_OPT_NUCLEUS

config IPIPE_WANT_ACTIVE_MM
        bool

config IPIPE_WANT_PREEMPTIBLE_SWITCH
        bool
	select IPIPE_WANT_ACTIVE_MM
	default y if XENO_HW_UNLOCKED_SWITCH
	default n if !XENO_HW_UNLOCKED_SWITCH

config XENO_HW_FPU
	bool "Enable FPU support"
	depends on SH_FPU
	default y
	help
	The FPU executes instructions from the processor's normal
	instruction stream. It can handle the types of high-precision
	floating-point processing operations commonly found in
	scientific, engineering, and business applications.
	If your target system has no FPU, say NO here; otherwise,
	enabling FPU support when the hardware is available may
	greatly improve	performance.

endmenu

source "kernel/xenomai/skins/Kconfig"
source "drivers/xenomai/Kconfig"
```

## ksrc/arch/x86/Kconfig
```kconfig
config XENO_GENERIC_STACKPOOL
	bool
	default y

config XENO_FASTSYNCH
	bool
	default y

source "kernel/xenomai/nucleus/Kconfig"

menu "Machine"

depends on XENO_OPT_NUCLEUS

config XENO_HW_FPU
	bool "Enable FPU support"
	default y
	help
	The FPU executes instructions from the processor's normal
	instruction stream. It can handle the types of high-precision
	floating-point processing operations commonly found in
	scientific, engineering, and business applications.
	If your target system has no FPU, say NO here; otherwise,
	enabling FPU support when available may greatly improve
	performance. You can obtain more information about the
	Float-Point Unit on the x86 platform at the following URL:
	http://www.intel.com/design/intarch/techinfo/Pentium/fpu.htm

endmenu

source "kernel/xenomai/skins/Kconfig"
source "drivers/xenomai/Kconfig"
```

## ksrc/drivers/16550A/Kconfig
```kconfig
config XENO_DRIVERS_16550A
	depends on XENO_SKIN_RTDM
	tristate "16550A UART driver"
	default n
	help
	Real-time UART driver for 16550A compatible controllers. See
	doc/txt/16550A-driver.txt for more details.
```

## ksrc/drivers/Config.in
```kconfig
#
# Xenomai configuration for Linux v2.4
#

if [ "$CONFIG_XENOMAI" = "y" \
     -a "$CONFIG_XENO_OPT_NUCLEUS" != "n" \
     -a "$CONFIG_XENO_SKIN_RTDM" != "n" ]; then
mainmenu_option next_comment
comment 'Real-time drivers'
	source drivers/xenomai/16550A/Config.in
	source drivers/xenomai/testing/Config.in
endmenu
fi
```

## ksrc/drivers/Kconfig
```kconfig
menu "Drivers"

depends on XENO_OPT_NUCLEUS

source "drivers/xenomai/serial/Kconfig"
source "drivers/xenomai/testing/Kconfig"
source "drivers/xenomai/can/Kconfig"
source "drivers/xenomai/analogy/Kconfig"
source "drivers/xenomai/ipc/Kconfig"

endmenu
```

## ksrc/drivers/analogy/Config.in
```kconfig
#
# Xenomai configuration for Linux v2.4
#

mainmenu_option next_comment
comment 'ANALOGY drivers'

dep_tristate 'ANALOGY interface' CONFIG_XENO_DRIVERS_ANALOGY $CONFIG_XENO_SKIN_RTDM

if [ "$CONFIG_XENO_DRIVERS_ANALOGY" != "n" ]; then
   source drivers/xenomai/analogy/testing/Config.in
   source drivers/xenomai/analogy/intel/Config.in
   source drivers/xenomai/analogy/national_instruments/Config.in
   source drivers/xenomai/analogy/sensoray/Config.in
fi

endmenu
```

## ksrc/drivers/analogy/intel/Kconfig
```kconfig
config XENO_DRIVERS_COMEDI_8255
	depends on XENO_DRIVERS_COMEDI && EXPERIMENTAL
	tristate "8255 driver (EXPERIMENTAL)"
	default n
```

## ksrc/drivers/analogy/national_instruments/Kconfig
```kconfig
config XENO_DRIVERS_ANALOGY_NI_MITE
	depends on XENO_DRIVERS_ANALOGY
	tristate "NI MITE driver"
	default n

config XENO_DRIVERS_ANALOGY_NI_TIO
	depends on XENO_DRIVERS_ANALOGY
	tristate "NI TIO driver"
	default n

config XENO_DRIVERS_ANALOGY_NI_MIO       
	depends on XENO_DRIVERS_ANALOGY && XENO_DRIVERS_ANALOGY_NI_TIO
	tristate "NI MIO driver"
	default n

config XENO_DRIVERS_ANALOGY_NI_PCIMIO       
	depends on XENO_DRIVERS_ANALOGY
	select XENO_DRIVERS_ANALOGY_NI_MITE
	select XENO_DRIVERS_ANALOGY_NI_TIO
	select XENO_DRIVERS_ANALOGY_NI_MIO
	select XENO_DRIVERS_ANALOGY_8255
	tristate "NI PCIMIO driver"
	default n
```

## ksrc/drivers/analogy/testing/Kconfig
```kconfig
config XENO_DRIVERS_ANALOGY_FAKE
	depends on XENO_DRIVERS_ANALOGY
	tristate "Fake driver"
	default n

config XENO_DRIVERS_ANALOGY_LOOP
	depends on XENO_DRIVERS_ANALOGY
	tristate "Loop driver"
	default n
```
