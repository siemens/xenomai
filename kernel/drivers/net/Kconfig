## kernel/drivers/net/Kconfig
```kconfig
menu "RTnet"

config XENO_DRIVERS_NET
       depends on m
       select NET
       tristate "RTnet, TCP/IP socket interface"

source "drivers/xenomai/net/stack/Kconfig"
source "drivers/xenomai/net/drivers/Kconfig"
source "drivers/xenomai/net/addons/Kconfig"

endmenu
```

## ksrc/Kconfig
```kconfig
menu "Interfaces"

depends on XENO_OPT_NUCLEUS

source "kernel/xenomai/native/Kconfig"
source "kernel/xenomai/posix/Kconfig"
source "kernel/xenomai/rtdm/Kconfig"

endmenu
```

## ksrc/arch/arm/Kconfig
```kconfig
config XENO_GENERIC_STACKPOOL
	bool
	default y

config XENO_FASTSYNCH_DEP
	bool
	default y if (CPU_32v3 || CPU_32v4 || CPU_32v4T || CPU_32v5) && !SMP || CPU_32v6 || CPU_32v7

config XENO_FASTSYNCH
	bool
	default y if XENO_FASTSYNCH_DEP

source "kernel/xenomai/nucleus/Kconfig"

menu "Machine"

depends on XENO_OPT_NUCLEUS

config IPIPE_WANT_PREEMPTIBLE_SWITCH
	bool
	default y if XENO_HW_UNLOCKED_SWITCH
	default n if !XENO_HW_UNLOCKED_SWITCH

config IPIPE_WANT_ACTIVE_MM
       def_bool y

config XENO_HW_FPU
	bool "Enable FPU support"
	default y
	help
	The FPU executes instructions from the processor's normal
	instruction stream. It can handle the types of high-precision
	floating-point processing operations commonly found in
	scientific, engineering, and business applications.
	If your target system has no FPU, say NO here; otherwise,
	enabling FPU support when the hardware is available may
	greatly improve	performance.

config XENO_HW_UNLOCKED_SWITCH
	bool "Enable unlocked context switch"
	default y
	help
	The nucleus may allow non-atomic execution of the
	machine-dependent context switching code, so that other CPUs
	and/or local interrupts may execute concurrently.

	This option reduces interrupt latency when costly cache and
	TLB flushes are required to switch context, and is mandatory
	on SMP/multi-core systems prior to Linux 3.8.

	You definitely want to enable that option on low-end ARM
	platforms.

endmenu

source "kernel/xenomai/skins/Kconfig"
source "drivers/xenomai/Kconfig"
```

## ksrc/arch/bfinnommu/Kconfig
```kconfig
source "kernel/xenomai/nucleus/Kconfig"

menu "Machine"

depends on XENO_OPT_NUCLEUS

config XENO_HW_PERIODIC_TIMER
	bool "Enable periodic timer support"
	default y
	help
	On this architecture, the nucleus provides both aperiodic and
	periodic timing modes. In aperiodic mode, timing accuracy is
	higher - since it is not rounded to a constant time slice - at
	the expense of a lesser efficicency when many timers are
	simultaneously active. The aperiodic mode gives better results
	in configuration involving a few threads requesting timing
	services over different time scales that cannot be easily
	expressed as multiples of a single base tick, or would lead to
	a waste of high frequency periodic ticks. You can disable
	the periodic support for this architecture to save a few
	hundreds bytes if you plan to use the system timer in
	aperiodic mode only.

config XENO_HW_TIMER_LATENCY
	int "Timer tuning latency (ns)"
	default 0
	help
	This parameter accounts for the time (in nanoseconds) needed
	to program the underlying time source in one-shot timing mode.
	This value will be used to reduce the scheduling jitter induced
	by the time needed to setup the timer for its next shot. A
	default value of 0 (recommended) will cause this value to be
	estimated by the nucleus at startup.

config XENO_HW_SCHED_LATENCY
	int "Scheduling latency (ns)"
	default 0
	help
	Scheduling latency is the time between the termination of an
	interrupt handler and the execution of the first instruction
	of the real-time thread this handler resumes. A
	default value of 0 (recommended) will cause this value to be
	estimated by the nucleus at startup.

menu "NMI watchdog"

config XENO_HW_NMI_DEBUG_LATENCY
        bool "Enable NMI watchdog"
        default n
        help
        Enabling this option allows the NMI watchdog to be used in order
        to debug abnormal (timer) interrupt latencies.

        The NMI watchog is programmed in order to expire a certain time 
        after the currently awaited timer shot, and triggers if the shot 
        did not happen as expected. This allowed amount of jitter is 
        configurable. When triggered, the NMI watchdog prints the call
        stack and causes a kernel panic, which should hopefully allow to
        find out why the timer got delayed.

        This option is mainly useful for debugging Xenomai internals, and 
        not meant for debugging applications.

config XENO_HW_NMI_DEBUG_LATENCY_MAX
        depends XENO_HW_NMI_DEBUG_LATENCY
        int "NMI watchdog latency threshold (us)"
        default 100
        help
        When the timer interrupt latency goes above this threshold, the
        NMI watchdog pulls the handbrake.

endmenu

endmenu

source "kernel/xenomai/skins/Kconfig"

menu "Drivers"

source "drivers/xenomai/Kconfig"

endmenu
```

## ksrc/arch/blackfin/Kconfig
```kconfig
config XENO_GENERIC_STACKPOOL
	bool
	default y

source "kernel/xenomai/nucleus/Kconfig"

menu "Machine"

depends on XENO_OPT_NUCLEUS

endmenu

source "kernel/xenomai/skins/Kconfig"
source "drivers/xenomai/Kconfig"
```

## ksrc/arch/i386/Config.in
```kconfig
mainmenu_option next_comment
comment 'Real-time sub-system'

bool 'Xenomai' CONFIG_XENOMAI

source kernel/xenomai/Config.in

if [ "$CONFIG_XENOMAI" = "y" -a "$CONFIG_XENO_OPT_NUCLEUS" != "n" ]; then

	mainmenu_option next_comment
	comment 'Machine'
	bool 'Enable FPU support' CONFIG_XENO_HW_FPU
	bool 'Enable periodic timer support' CONFIG_XENO_HW_PERIODIC_TIMER
	int 'Timer tuning latency (ns)' CONFIG_XENO_HW_TIMER_LATENCY 0
	int 'Scheduling latency (ns)' CONFIG_XENO_HW_SCHED_LATENCY 0

	mainmenu_option next_comment
	comment 'NMI watchdog'
	bool 'Enable NMI watchdog' CONFIG_XENO_HW_NMI_DEBUG_LATENCY
	if [ "$CONFIG_XENO_HW_NMI_DEBUG_LATENCY" != "n" ]; then
	    int 'NMI watchdog latency threshold (us)' CONFIG_XENO_HW_NMI_DEBUG_LATENCY_MAX 0
	fi
	endmenu
	mainmenu_option next_comment
	comment 'SMI workaround'
	bool 'Disable SMI detection' CONFIG_XENO_HW_SMI_DETECT_DISABLE
	if [ "$CONFIG_XENO_HW_SMI_DETECT_DISABLE" != "y" ]; then
	   define_bool CONFIG_XENO_HW_SMI_DETECT y
	   bool 'Enable SMI workaround' CONFIG_XENO_HW_SMI_WORKAROUND
	   if [ "$CONFIG_XENO_HW_SMI_WORKAROUND" != "n" ]; then
	      bool 'Globally disable SMI' CONFIG_XENO_HW_SMI_ALL
	      if [ "$CONFIG_XENO_HW_SMI_ALL" != "y" ]; then
	         bool 'Enable Intel-Specific USB2 SMI' CONFIG_XENO_HW_SMI_INTEL_USB2
	         bool 'Enable legacy USB2 SMI' CONFIG_XENO_HW_SMI_LEGACY_USB2
	         bool 'Enable periodic SMI' CONFIG_XENO_HW_SMI_PERIODIC
	         bool 'Enable TCO SMI' CONFIG_XENO_HW_SMI_TCO
	         bool 'Enable microcontroller SMI' CONFIG_XENO_HW_SMI_MC
	         bool 'Enable APM SMI' CONFIG_XENO_HW_SMI_APMC
	         bool 'Enable legacy USB SMI' CONFIG_XENO_HW_SMI_LEGACY_USB
	         bool 'Enable ACPI BIOS SMI' CONFIG_XENO_HW_SMI_BIOS
              fi
	   fi
	fi
	endmenu
	endmenu
fi

endmenu
```

## ksrc/arch/i386/Kconfig
```kconfig
source "kernel/xenomai/nucleus/Kconfig"

menu "Machine"

depends on XENO_OPT_NUCLEUS

config XENO_HW_FPU
	bool "Enable FPU support"
	default y
	help
	The FPU executes instructions from the processor's normal
	instruction stream. It can handle the types of high-precision
	floating-point processing operations commonly found in
	scientific, engineering, and business applications.
	If your target system has no FPU, say NO here; otherwise,
	enabling FPU support when available may greatly improve
	performance. You can obtain more information about the
	Float-Point Unit on the x86 platform at the following URL:
	http://www.intel.com/design/intarch/techinfo/Pentium/fpu.htm

config XENO_HW_PERIODIC_TIMER
	bool "Enable periodic timer support"
	default y
	help
	On this architecture, the nucleus provides both aperiodic and
	periodic timing modes. In aperiodic mode, timing accuracy is
	higher - since it is not rounded to a constant time slice - at
	the expense of a lesser efficicency when many timers are
	simultaneously active. The aperiodic mode gives better results
	in configuration involving a few threads requesting timing
	services over different time scales that cannot be easily
	expressed as multiples of a single base tick, or would lead to
	a waste of high frequency periodic ticks. You can disable
	the periodic support for this architecture to save a few
	hundreds bytes if you plan to use the system timer in
	aperiodic mode only.

config XENO_HW_TIMER_LATENCY
	int "Timer tuning latency (ns)"
	default 0
	help
	This parameter accounts for the time (in nanoseconds) needed
	to program the underlying time source in one-shot timing mode.
	This value will be used to reduce the scheduling jitter induced
	by the time needed to setup the timer for its next shot. A
	default value of 0 (recommended) will cause this value to be
	estimated by the nucleus at startup.
	Depending on whether CONFIG_X86_LOCAL_APIC is enabled or not
	in the kernel configuration Xenomai is compiled
	against, CONFIG_XENO_HW_TIMER_LATENCY will either refer to the
	local APIC or 8254 timer latency value.

config XENO_HW_SCHED_LATENCY
	int "Scheduling latency (ns)"
	default 0
	help
	Scheduling latency is the time between the termination of an
	interrupt handler and the execution of the first instruction
	of the real-time thread this handler resumes. A default value
	of 0 (recommended) will cause this value to be estimated by
	the nucleus at startup.

menu "NMI watchdog"

config XENO_HW_NMI_DEBUG_LATENCY
        depends on X86_LOCAL_APIC
        bool "Enable NMI watchdog"
        default n
        help
        Enabling this option allows the NMI watchdog to be used in order
        to debug abnormal (timer) interrupt latencies.

        The NMI watchog is programmed in order to expire a certain time 
        after the currently awaited timer shot, and triggers if the shot 
        did not happen as expected. This allowed amount of jitter is 
        configurable. When triggered, the NMI watchdog prints the call
        stack and causes a kernel panic, which should hopefully allow to
        find out why the timer got delayed.

        This option is mainly useful for debugging Xenomai internals, and 
        not meant for debugging applications.

config XENO_HW_NMI_DEBUG_LATENCY_MAX
        depends XENO_HW_NMI_DEBUG_LATENCY
        int "NMI watchdog latency threshold (us)"
        default 100
        help
        When the timer interrupt latency goes above this threshold, the
        NMI watchdog pulls the handbrake.

endmenu

menu "SMI workaround"

config XENO_HW_SMI_DETECT_DISABLE
        bool "Disable SMI detection"
        default n
        help
        SMI are System Management Interrupts, generated by Intel ICH
        (I/O connector hubs) to allow handling of some specific events;
        on systems where they exist, they are the highest priority
        interrupts (even higher priority than NMIs). Common SMI sources
        are power management, legacy devices emulation by BIOS, SMBus
        and TCO watchdog. 

        SMI are problematic for Xenomai, because their handling may span
        accross hundreds of microseconds, causing unacceptable interrupt 
        latency. Furthermore, their vectors are stored in some ROM, 
        and hence may not be altered.

        For this reason, Xenomai contains code to detect chipsets using
        SMIs and optionnaly activate some workarounds to stop SMIs.
        
        Enabling this option will cause Xenomai not to try and detect whether 
        your hardware use SMIs. This option is mostly useful if you know
        that your system does not use SMIs and really want to size Xenomai 
        modules down. The detection code has no run-time space overhead,
        only disk-space overhead.

config XENO_HW_SMI_DETECT
        bool
        depends on !XENO_HW_SMI_DETECT_DISABLE
        default y

config XENO_HW_SMI_WORKAROUND
        depends on XENO_HW_SMI_DETECT
        bool "Enable SMI workaround"
        default n
        help
        SMI are System Management Interrupts, generated by Intel ICH
        (I/O connector hubs) to allow handling of some specific events;
        on systems where they exist, they are the highest priority
        interrupts (even higher priority than NMIs). Common SMI sources
        are power management, legacy devices emulation by BIOS, SMBus
        and TCO watchdog. 

        SMI are problematic for Xenomai, because their handling may span
        accross hundreds of microseconds, causing unacceptable interrupt 
        latency. Furthermore, their vectors are stored in some ROM, 
        and hence may not be altered.

        For this reason, Xenomai contains code to detect chipsets using
        SMIs and optionnaly activate some workarounds to stop SMIs.
        Enabling this option cause those workarounds to be activated.

if XENO_HW_SMI_WORKAROUND

config XENO_HW_SMI_ALL
        bool "Globally disable SMI"
        default y
        help
        This option causes the SMIs to be globally disabled, which avoid
        any jitter they could cause with a big drawback: any peripheral or
        feature relying on them will stop working when Xenomai is running.

        The alternative is to selectively enable the SMIs sources needed 
        by your peripherals. The main drawback is that the peripheral 
        which you need may be the one causing jitter, so that extensive
        testing is needed when choosing to not disable SMI globally. 
        Another drawback is that other unknown SMI sources may exist which
        Xenomai can not disable.

        This option causes the SMIs to be globally disabled.

config XENO_HW_SMI_INTEL_USB2
        bool "Enable Intel-Specific USB2 SMI"
        depends on !XENO_HW_SMI_ALL
        default n
        help
        This options enables Intel-specific USB2 SMI logic to cause SMIs.

config XENO_HW_SMI_LEGACY_USB2
        bool "Enable legacy USB2 SMI"
        depends on !XENO_HW_SMI_ALL
        default n
        help
        This options enables legacy USB2 logic to cause SMIs.

config XENO_HW_SMI_PERIODIC
        bool "Enable periodic SMI"
        depends on !XENO_HW_SMI_ALL
        default n
        help
        This options enables the ICH to generate a periodic SMI.

config XENO_HW_SMI_TCO
        bool "Enable TCO SMI"
        depends on !XENO_HW_SMI_ALL
        default n
        help
        This options enables the TCO logic to generate SMIs.

config XENO_HW_SMI_MC
        bool "Enable microcontroller SMI"
        depends on !XENO_HW_SMI_ALL
        default n
        help
        This options enables the ICH to trap access to the 
        microcontroller range.

config XENO_HW_SMI_APMC
        bool "Enable APM SMI"
        depends on !XENO_HW_SMI_ALL
        default n
        help
        This options enables writes to the APM control register to 
        cause SMIs.

config XENO_HW_SMI_LEGACY_USB
        bool "Enable legacy USB SMI"
        depends on !XENO_HW_SMI_ALL
        default n
        help
        This options enables legacy USB circuit to cause SMIs.

config XENO_HW_SMI_BIOS
        bool "Enable ACPI BIOS SMI"
        depends on !XENO_HW_SMI_ALL
        default n
        help
        This options enables SMI to be used for communication
        between ACPI software and BIOS software.

endif

endmenu

endmenu

source "kernel/xenomai/skins/Kconfig"

menu "Drivers"

depends on XENO_OPT_NUCLEUS

source "drivers/xenomai/Kconfig"

endmenu
```

## ksrc/arch/nios2/Kconfig
```kconfig
config XENO_GENERIC_STACKPOOL
	bool
	default y

source "kernel/xenomai/nucleus/Kconfig"
source "kernel/xenomai/Kconfig"
source "drivers/xenomai/Kconfig"
```
