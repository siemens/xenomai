## kernel/cobalt/Kconfig
```kconfig
menu "Core features"

config XENO_OPT_SCHED_CLASSES
	bool "Extra scheduling classes"
	default n
	help

	Xenomai implements a set of scheduling classes.  Each
	scheduling class defines its own set of rules for determining
	when and how to select a new thread to run.

	The Xenomai core has a built-in real-time class, which
	supports both preemptive fixed-priority FIFO, and round-robin
	scheduling.

	When CONFIG_XENO_OPT_SCHED_WEAK is disabled, Xenomai's
	real-time class also supports threads from the SCHED_OTHER
	class at FIFO priority level 0. Such threads can access
	Xenomai resources, wait on Xenomai synchronization objects,
	without competing for the CPU with members of other scheduling
	classes.

	NOTE: Xenomai assumes no real-time requirement for SCHED_OTHER
	threads. Therefore, they are automatically moved back to
	secondary mode upon return from a Xenomai syscall, unless they
	hold a mutex, which would defer the transition until the mutex
	is released.

	Enabling CONFIG_XENO_OPT_SCHED_CLASSES will allow you to
	select additional scheduling classes to compile in.

	If in doubt, say N.

config XENO_OPT_SCHED_WEAK
	bool "Weak scheduling class"
	default n
	depends on XENO_OPT_SCHED_CLASSES
	help

	This option enables support for binding threads from the Linux
	SCHED_FIFO/RR scheduling classes to the Xenomai domain as
	members of the SCHED_WEAK class, with up to 100 priority
	levels from [0..99] included.  When enabled, SCHED_WEAK is the
	low priority class of the Xenomai system, providing no
	real-time guarantee.

	Members from the SCHED_WEAK class are weakly scheduled by
	Xenomai, only for the purpose of synchronizing with real-time
	threads from other scheduling classes.  However, they cannot
	compete for CPU resources with real-time threads, and leave
	the primary domain upon return from Xenomai syscalls
	automatically (*).

	This feature is an extension of Xenomai's special handling of
	SCHED_OTHER threads, to the SCHED_FIFO/RR POSIX classes from a
	regular Linux kernel. If disabled, SCHED_WEAK is interpreted
	as an alias to SCHED_OTHER by the Xenomai scheduler,
	restricted to priority 0. Conversely, SCHED_OTHER threads are
	eventually members of Xenomai's SCHED_WEAK class at priority
	0, when this feature is enabled.

	If in doubt, say N.

	(*) With a special exception when a mutex is held. See NOTE
	from CONFIG_XENO_OPT_SCHED_CLASSES.

config XENO_OPT_SCHED_TP
	bool "Temporal partitioning"
	default n
	depends on XENO_OPT_SCHED_CLASSES
	help

	This option enables support for temporal partitioning.

	If in doubt, say N.

config XENO_OPT_SCHED_TP_NRPART
	int "Number of partitions"
	default 4
	range 1 1024
	depends on XENO_OPT_SCHED_TP
	help

	Define here the maximum number of temporal partitions the TP
	scheduler may have to handle.

config XENO_OPT_SCHED_SPORADIC
	bool "Sporadic scheduling"
	default n
	depends on XENO_OPT_SCHED_CLASSES
	help

	This option enables support for the sporadic scheduling policy
	in Xenomai (SCHED_SPORADIC), also known as POSIX sporadic
	server.

	It can be used to enforce a capped limit on the execution time
	of a thread within a given period of time.

	If in doubt, say N.

config XENO_OPT_SCHED_SPORADIC_MAXREPL
	int "Maximum number of pending replenishments"
	default 8
	range 4 16
	depends on XENO_OPT_SCHED_SPORADIC
	help

	For performance reason, the budget replenishment information
	is statically stored on a per-thread basis. This parameter
	defines the maximum number of replenishment requests that can
	be pending concurrently for any given thread that undergoes
	sporadic scheduling (system minimum is 4).

config XENO_OPT_SCHED_QUOTA
	bool "Thread groups with runtime quota"
	default n
	depends on XENO_OPT_SCHED_CLASSES
	help

	This option enables the SCHED_QUOTA scheduling policy for
	Xenomai.

	This policy enforces a limitation on the CPU consumption of
	threads over a globally defined period, known as the quota
	interval. This is done by pooling threads with common
	requirements in groups, and giving each group a share of the
	global period (see CONFIG_XENO_OPT_SCHED_QUOTA_PERIOD).

	When threads have entirely consumed the quota allotted to the
	group they belong to, the latter is suspended as a whole,
	until the next quota interval starts. At this point, a new
	runtime budget is given to each group, in accordance with its
	share.

	If in doubt, say N.

config XENO_OPT_SCHED_QUOTA_PERIOD
	int "Quota interval (us)"
	default 10000
	range 100 1000000000
	depends on XENO_OPT_SCHED_QUOTA
	help

	The global period thread groups can get a share of.

config XENO_OPT_SCHED_QUOTA_NR_GROUPS
	int "Number of thread groups"
	default 32
	range 1 1024
	depends on XENO_OPT_SCHED_QUOTA
	help

	The overall number of thread groups which may be defined
	across all CPUs.

config XENO_OPT_STATS
	bool "Runtime statistics"
	depends on XENO_OPT_VFILE
	default y
	help

	This option causes the real-time nucleus to collect various
	per-thread runtime statistics, which are accessible through
	the /proc/xenomai/sched/stat interface.

config XENO_OPT_SHIRQ
	bool "Shared interrupts"
	help

	Enables support for both level- and edge-triggered shared
	interrupts, so that multiple real-time interrupt handlers
	are allowed to control dedicated hardware devices which are
	configured to share the same interrupt line.

config XENO_OPT_RR_QUANTUM
	int "Round-robin quantum (us)"
	default 1000
	help

	This parameter defines the duration of the default round-robin
	time quantum expressed as a count of micro-seconds. This value
	may be overriden internally by Xenomai services which do
	provide a round-robin interval.

config XENO_OPT_AUTOTUNE
        bool "Auto-tuning"
        default y if XENO_HW_AUTOTUNE
	select XENO_DRIVERS_AUTOTUNE
        help
	Enable auto-tuning capabilities. Currently, Xenomai runs an
	auto-tuning procedure once at system bootup, for adjusting the
	core timing services to the intrinsic latency of the platform.

	The calibration method is conservative, in order to never
	cause early shots. You can set your own estimation of the
	intrinsic latency with CONFIG_XENO_OPT_TIMING_SCHEDLAT, or use
	our pre-calibrated value instead.

if XENO_OPT_AUTOTUNE
config XENO_OPT_TIMING_SCHEDLAT
	int
	default 0
endif

config XENO_OPT_TIMING_SCHEDLAT
	int "Scheduling latency (ns)"
	default 0
	depends on !XENO_OPT_AUTOTUNE
	help
	Scheduling latency is the time between the termination of an
	interrupt handler and the execution of the first instruction
	of the real-time thread this handler resumes. A default value
	of 0 (recommended) will cause a pre-calibrated value to be
	used.

config XENO_OPT_SCALABLE_SCHED
	bool "O(1) scheduler"
	help

	This option causes a multi-level priority queue to be
	used in the real-time thread scheduler, so that it operates
	in constant-time regardless of the number of _concurrently
	runnable_ threads (which might be much lower than the total
	number of active threads).

	Its use is recommended for large multi-threaded systems
	involving more than 10 of such threads; otherwise, the default
	linear method usually performs better with lower memory
	footprints.

choice
	prompt "Timer indexing method"
	default XENO_OPT_TIMER_LIST
	help

	This option allows to select the underlying data structure
	which is going to be used for ordering the outstanding
	software timers managed by the nucleus.

config XENO_OPT_TIMER_LIST
	bool "Linear"
	help

	Use a linked list. Albeit O(N), this simple data structure is
	particularly efficient when only a few timers (< 10) may be
	concurrently outstanding at any point in time.

config XENO_OPT_TIMER_HEAP
	bool "Tree"
	help

	Use a binary heap. This data structure is efficient when a
	high number of software timers may be concurrently
	outstanding at any point in time.

endchoice

config XENO_OPT_TIMER_HEAP_CAPACITY
	int "Binary heap capacity"
	depends on XENO_OPT_TIMER_HEAP
	default 256
	help

	Set the maximum number of timers in the nucleus timers list.

config XENO_OPT_HOSTRT
       depends on IPIPE_HAVE_HOSTRT
       def_bool y

config XENO_OPT_PIPE
	bool

config XENO_OPT_MAP
	bool

config XENO_OPT_EXTCLOCK
       bool

config XENO_OPT_COBALT_EXTENSION
       bool

config XENO_OPT_VFILE
       bool
       depends on PROC_FS
       default y

endmenu

menu "Sizes and static limits"

config XENO_OPT_PIPE_NRDEV
	int "Number of pipe devices"
	depends on XENO_OPT_PIPE
	default 32
	help

	Message pipes are bi-directional FIFO communication
	channels allowing data exchange between real-time kernel
	threads and regular user-space processes. Pipes natively
	preserve message boundaries, but can also be used in byte
	streaming mode from kernel to user-space.

	This option sets the maximum number of pipe devices supported
	in the system. Pipe devices are named /dev/rtpN where N is a
	device minor number ranging from 0 to XENO_OPT_PIPE_NRDEV - 1.

config XENO_OPT_REGISTRY_NRSLOTS
	int "Number of registry slots"
	default 512
	help

	The registry is used by Xenomai-based APIs to bind real-time
	objects they create to symbolic names, so that these objects
	can be further retrieved and shared by real-time applications
	regardless of their runtime space (i.e. kernel or user). Each
	named object occupies a registry slot.

	This option sets the maximum number of real-time objects the
	registry can handle. All APIs using the registry share this
	storage.

config XENO_OPT_SYS_HEAPSZ
	int "Size of the system heap (Kb)"
	default 256
	help

	The system heap is used for various internal allocations by
	the nucleus and the real-time APIs. The size is expressed in
	Kilobytes.

config XENO_OPT_SEM_HEAPSZ
	int "Size of private semaphores heap (Kb)"
	default 32
	help

	Xenomai implementation of user-space semaphores relies on heaps
	shared between kernel and user-space. This configuration entry
	allow to set the size of the heap used for private semaphores.

	Note that each semaphore will allocate 4 bytes on 32 bits
	architectures or 8 bytes on 64 bits architectures of memory,
	so, the default of 32 Kb allows creating many semaphores.

config XENO_OPT_GLOBAL_SEM_HEAPSZ
	int "Size of global semaphores heap (Kb)"
	default 32
	help

	Xenomai implementation of user-space semaphores relies on heaps
	shared between kernel and user-space. This configuration entry
	allow to set the size of the heap used for semaphores shared
	between several processes.

	Note that each semaphore will allocate 4 bytes on 32 bits
	architectures or 8 bytes on 64 bits architectures of memory,
	so, the default of 32 Kb allows creating many semaphores.

config XENO_OPT_NRTIMERS
       int "Maximum number of POSIX timers per process"
       default 128
       help

       This tunable controls how many POSIX timers can exist at any
       given time for each Xenomai process (a timer is created by a
       call to the timer_create() service of the Cobalt/POSIX API).

config XENO_OPT_RTDM_FILDES
	int "Maximum number of RTDM file descriptors"
	default 128
	help

	This option defines the maximum number of kernel-space RTDM
	file descriptors which can be opened at the same time. RTDM
	kernel-space file descriptors are a global resource.

endmenu

menuconfig XENO_OPT_DEBUG
	depends on XENO_OPT_VFILE
	bool "Debug support"
	help

	When enabled, various debugging features can be switched
	on. They can help to find problems in applications, drivers,
	and the Xenomai core. XENO_OPT_DEBUG by itself does not have
	any impact on generated code.

if XENO_OPT_DEBUG

config XENO_OPT_DEBUG_NUCLEUS
	bool "Nucleus runtime assertions"
	help

	This option activates various assertions inside the core
	system. This option has limited overhead.

config XENO_OPT_DEBUG_CONTEXT
       bool "Check for calling context"
       help

       This option enables checks for the calling context in the
       Xenomai code, aimed at detecting when regular linux code is
       entered from a real-time context, and conversely.

config XENO_OPT_DEBUG_LOCKING
	bool "Spinlock debugging support"
	default y if SMP
	help

	This option activates runtime assertions, and measurements of
	Xenomai spinlocks spinning time and duration. It should have a
	low overhead, and helps finding latency spots due to masking
	sections. Statistics about the longest masking section may be
	found in /proc/xenomai/lock.

config XENO_OPT_DEBUG_SYNCH_RELAX
	bool "Detect mutexes held in relaxed sections"
	default y
	help

	This option detects situations where a real-time thread
	attempts to sleep on a Xenomai mutex object, that is owned by
	another thread currently running in secondary mode (i.e. plain
	Linux execution mode). The SIGDEBUG signal may be sent in such
	a case to the sleeper, provided the WARNSW flag is enabled for
	it, as set by e.g. rt_task_set_mode() or pthread_setmode_np().

	This particular situation is a possible source of unwanted
	latency, since the current mutex owner may be unexpectedly
	delayed as a result of using non-deterministic Linux services,
	thus deferring the release of the mutex object for too long.

	This option may introduce some overhead in case mutexes are
	highly contended. Use this feature for debugging purposes
	only.

	NOTE: only Xenomai synchronization objects that may be
	actually "owned" by a single thread at a time, can be
	monitored this way (typically, mutexes).

config XENO_OPT_DEBUG_TRACE_RELAX
	bool "Trace relax requests"
	help

	This option enables recording of unwanted relax requests from
	user-space applications leaving the real-time domain, logging
	the thread information and code location involved. All records
	are readable from /proc/xenomai/debug/relax, and can be
	decoded using the "slackspot" utility.

config XENO_OPT_WATCHDOG
	bool "Watchdog support"
	default y
	help

	This option activates a watchdog aimed at detecting runaway
	real-time threads. If enabled, the watchdog triggers after
	a given period of uninterrupted real-time activity has elapsed
	without Linux interaction in the meantime; in such event, the
	current real-time thread is killed. The built-in watchdog
	support operates on behalf of the timer tick handler,
	thus is only active after the timer has been started. The
	timeout value of the watchdog can be set using the
	XENO_OPT_WATCHDOG_TIMEOUT parameter.

config XENO_OPT_WATCHDOG_TIMEOUT
	depends on XENO_OPT_WATCHDOG
	int "Watchdog timeout"
	default 4
	range 1 60
	help

	Watchdog timeout value (in seconds).

config XENO_OPT_DEBUG_COBALT
	bool "Cobalt debugging support"
	default n
	help

	This option activates various checks inside the Cobalt API,
	mainly to help debugging applications. This option has no
	significant overhead.

config XENO_OPT_DEBUG_RTDM
	bool "RTDM debugging checks"
	default y
	help

	This option activates debugging checks for the RTDM subsystem.
	It is a recommended option for analysing potential issues in
	RTDM drivers. A minor runtime overhead is added.

config XENO_OPT_DEBUG_RTDM_APPL
	bool "RTDM application cleanup checks"
	default y
	help

	When enabled, this option makes RTDM warn about auto-clean
	operations executed upon application termination.

endif # XENO_OPT_DEBUG
```
