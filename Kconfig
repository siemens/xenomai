## kernel/drivers/analogy/Kconfig
```kconfig
menu "ANALOGY drivers"

config XENO_DRIVERS_ANALOGY
	depends on XENO_SKIN_RTDM
	tristate "ANALOGY interface"
	help

	ANALOGY is a framework aimed at supporting data acquisition
	devices.

config XENO_DRIVERS_ANALOGY_DEBUG
       depends on XENO_DRIVERS_ANALOGY
       bool "Analogy debug trace"
       default y
       help

       Enable debugging traces in Analogy so as to monitor Analogy's
       core and drivers behaviours.

config XENO_DRIVERS_ANALOGY_DEBUG_LEVEL
       depends on XENO_DRIVERS_ANALOGY_DEBUG
       int "Analogy core debug level threshold"
       default 0
       help

       Define the level above which the debugging traces will not be
       displayed.

       WARNING: this threshold is only applied on the Analogy
       core. That will not affect the driver.

config XENO_DRIVERS_ANALOGY_DRIVER_DEBUG_LEVEL
       depends on XENO_DRIVERS_ANALOGY_DEBUG
       int "Analogy driver debug level threshold"
       default 0
       help

       Define the level above which the debugging traces will not be
       displayed.

       WARNING: this threshold is only applied on the Analogy
       driver. That will not affect the core.

source drivers/xenomai/analogy/testing/Kconfig
source drivers/xenomai/analogy/intel/Kconfig
source drivers/xenomai/analogy/national_instruments/Kconfig
source drivers/xenomai/analogy/sensoray/Kconfig

endmenu
```

## kernel/drivers/can/mscan/Kconfig
```kconfig
config XENO_DRIVERS_CAN_MSCAN
	depends on XENO_DRIVERS_CAN && (PPC_MPC52xx || PPC_MPC512x)
	tristate "MSCAN driver for MPC52xx and MPC512x"
	default n
	help

	This driver is for the MSCAN on the MPC5200 and MPC512x processor
	from Freescale.

config XENO_DRIVERS_CAN_MSCAN_OLD
	depends on XENO_DRIVERS_CAN_MSCAN && PPC_MPC52xx
	bool "Use old MSCAN driver for old kernel version"
	default n
	help

	For backward compatibility with older kernel versions, you may
	want to select the old MSCAN driver for the MPC5200.

if XENO_DRIVERS_CAN_MSCAN_OLD

config XENO_DRIVERS_CAN_MSCAN_1
	depends on XENO_DRIVERS_CAN_MSCAN
	bool "Enable CAN 1"
	default y

config XENO_DRIVERS_CAN_MSCAN_2
	depends on XENO_DRIVERS_CAN_MSCAN
	bool "Enable CAN 2"
	default y

config XENO_DRIVERS_CAN_MSCAN_CLOCK
	depends on XENO_DRIVERS_CAN_MSCAN
	int "Clock Frequency in Hz"
	default 66000000
	help

	The MSCAN driver selects the oscillator clock (SYS_XTAL_IN) as clock
	source for MSCAN, which is typically 33 MHz. Due to a hardware bug on
	the MPC5200 Rev. A chips, the IP bus clock (IP_CLK) is used instead,
	which is typically 66 or 132 MHz.

choice
	depends on XENO_DRIVERS_CAN_MSCAN
	prompt "Pin Configuration"
	default XENO_DRIVERS_CAN_MSCAN_PRE
	help

config XENO_DRIVERS_CAN_MSCAN_PRE
	bool "Use pre-configured CAN routing"

config XENO_DRIVERS_CAN_MSCAN_ALT
	bool "CAN 1 on I2C1 pins, CAN 2 on TMR01 pins"

config XENO_DRIVERS_CAN_MSCAN_PSC2
	bool "CAN 1 and 2 on PSC2 pins"

endchoice

endif
```

## kernel/drivers/gpio/Kconfig
```kconfig
menu "Real-time GPIO drivers"

config XENO_DRIVERS_GPIO
       tristate
       depends on GPIOLIB

config XENO_DRIVERS_GPIO_BCM2708
	depends on MACH_BCM2708
	select XENO_DRIVERS_GPIO
	tristate "Support for BCM2708 GPIOs"
	help

	Suitable for the GPIO controller present on Broadcom's BCM2708
	chip family.

config XENO_DRIVERS_GPIO_MXC
	depends on GPIO_MXC
	select XENO_DRIVERS_GPIO
	tristate "Support for MXC GPIOs"
	help

	Suitable for the GPIO controller available from
	Freescale/NXP's MXC architecture.

config XENO_DRIVERS_GPIO_DEBUG
       depends on XENO_DRIVERS_GPIO
       bool "Enable GPIO core debugging features"
       
endmenu
```
