## kernel/cobalt/arch/arm/Kconfig
```kconfig
source "kernel/xenomai/Kconfig"
source "drivers/xenomai/Kconfig"

menu "Platform-specific options"

config XENO_HW_UNLOCKED_SWITCH
	bool "Unlocked context switch"
	default y
	help
	The Cobalt core may allow non-atomic execution of the
	machine-dependent context switching code, so that other CPUs
	and/or local interrupts may execute concurrently.

	This option reduces interrupt latency when costly cache and
	TLB flushes are required to switch context.

	You definitely want to enable that option on low-end ARM
	platforms.
endmenu

config IPIPE_WANT_PREEMPTIBLE_SWITCH
	bool
	default y if XENO_HW_UNLOCKED_SWITCH
	default n if !XENO_HW_UNLOCKED_SWITCH

config IPIPE_WANT_ACTIVE_MM
       def_bool y

config XENO_HW_WANT_TIP
       def_bool y

config XENO_HW_FPU
	def_bool VFP

config XENO_HW_OUTOFLINE_XNLOCK
       bool
       default y
```

## kernel/cobalt/arch/arm64/Kconfig
```kconfig
source "kernel/xenomai/Kconfig"
source "drivers/xenomai/Kconfig"

config XENO_ARCH_UNLOCKED_SWITCH
       def_bool IPIPE_WANT_PREEMPTIBLE_SWITCH

config XENO_ARCH_WANT_TIP
       def_bool y

config XENO_ARCH_FPU
	def_bool y

config XENO_ARCH_SYS3264
        def_bool n

config XENO_ARCH_OUTOFLINE_XNLOCK
       bool
       default y
```

## kernel/cobalt/arch/blackfin/Kconfig
```kconfig
config XENO_ARCH_FPU
	def_bool n

source "kernel/xenomai/Kconfig"
source "drivers/xenomai/Kconfig"
```

## kernel/cobalt/arch/nios2/Kconfig
```kconfig
config XENO_GENERIC_STACKPOOL
	bool
	default y

source "kernel/xenomai/Kconfig"
source "kernel/xenomai/posix/Kconfig"
source "kernel/xenomai/rtdm/Kconfig"
source "kernel/xenomai/native/Kconfig"
source "drivers/xenomai/Kconfig"
```

## kernel/cobalt/arch/powerpc/Kconfig
```kconfig
source "kernel/xenomai/Kconfig"
source "drivers/xenomai/Kconfig"

config XENO_ARCH_MATH_EMU
        bool
	default y if MATH_EMU || MATH_EMULATION

config XENO_ARCH_FPU
	def_bool PPC_FPU

config XENO_ARCH_SYS3264
        def_bool n

config XENO_ARCH_UNLOCKED_SWITCH
	def_bool n
```

## kernel/cobalt/arch/sh/Kconfig
```kconfig
config IPIPE_WANT_ACTIVE_MM
        bool

config XENO_ARCH_FPU
	def_bool SH_FPU

config XENO_ARCH_SYS3264
        def_bool n

menu "Machine/platform-specific options"

config IPIPE_WANT_PREEMPTIBLE_SWITCH
        bool
	select IPIPE_WANT_ACTIVE_MM
	default y if XENO_ARCH_UNLOCKED_SWITCH
	default n if !XENO_ARCH_UNLOCKED_SWITCH

endmenu

source "kernel/xenomai/Kconfig"
source "drivers/xenomai/Kconfig"
```

## kernel/cobalt/arch/x86/Kconfig
```kconfig
config XENO_ARCH_FPU
	def_bool y

config XENO_ARCH_X32
        def_bool X86_X32
	select XENO_OPT_SYS3264

source "kernel/xenomai/Kconfig"
source "drivers/xenomai/Kconfig"
```
