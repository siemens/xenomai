## arch/ia64/Kconfig
```kconfig
mainmenu "Xenomai/ia64 configuration"

source Kconfig

source "nucleus/Kconfig"

menu "Machine (ia64)"

config XENO_HW_PERIODIC_TIMER
	bool "Enable periodic timer support"
	default y
	help
	On this architecture, the nucleus provides both aperiodic and
	periodic timing modes. In aperiodic mode, timing accuracy is
	higher - since it is not rounded to a constant time slice - at
	the expense of a lesser efficicency when many timers are
	simultaneously active. The aperiodic mode gives better results
	in configuration involving a few threads requesting timing
	services over different time scales that cannot be easily
	expressed as multiples of a single base tick, or would lead to
	a waste of high frequency periodic ticks. You can disable
	the periodic support for this architecture to save a few
	hundreds bytes if you plan to use the system timer in
	aperiodic mode only.

config XENO_HW_TIMER_LATENCY
	depends on XENO_OPT_EXPERT
	string "Timer tuning latency (ns)"
	default 0
	help
	This parameter accounts for the time (in nanoseconds) needed
	to program the underlying time source in one-shot timing mode.
	This value will be used to reduce the scheduling jitter induced
	by the time needed to setup the timer for its next shot. A
	default value of 0 (recommended) will cause this value to be
	estimated by the nucleus at startup.

config XENO_HW_SCHED_LATENCY
	depends on XENO_OPT_EXPERT
	string "Scheduling latency (ns)"
	default 0
	help
	Scheduling latency is the time between the termination of an
	interrupt handler and the execution of the first instruction
	of the real-time thread this handler resumes. A
	default value of 0 (recommended) will cause this value to be
	estimated by the nucleus at startup.

config XENO_HW_IA64_STACK_POOL
        string "Number of pre-allocated kernel stacks"
        default 4
        help
	The current implementation for the Itanium architecture
	requires that stacks of Xenomai threads running in kernel
	space be pre-allocated in a separate pool. This parameter
	allows to set the size of this stack spool, which consequently
	defines the maximum number of concurrently runnable
	kernel-based threads at any point in time. Nb: Xenomai
	threads running in user-space are _not_ impacted by this
	limit.

endmenu

source "skins/Kconfig"

source "sim/Kconfig"
```

## arch/ppc64/Kconfig
```kconfig
mainmenu "Xenomai/powerpc64 configuration"

source Kconfig

source "nucleus/Kconfig"

menu "Machine (powerpc64)"

config XENO_HW_FPU
	bool "Enable FPU support"
	default y
	help
	The FPU executes instructions from the processor's normal
	instruction stream. It can handle the types of high-precision
	floating-point processing operations commonly found in
	scientific, engineering, and business applications.
	If your target system has no FPU, say NO here; otherwise,
	enabling FPU support when the hardware is available may
	greatly improve	performance.

config XENO_HW_PERIODIC_TIMER
	bool "Enable periodic timer support"
	default y
	help
	On this architecture, the nucleus provides both aperiodic and
	periodic timing modes. In aperiodic mode, timing accuracy is
	higher - since it is not rounded to a constant time slice - at
	the expense of a lesser efficicency when many timers are
	simultaneously active. The aperiodic mode gives better results
	in configuration involving a few threads requesting timing
	services over different time scales that cannot be easily
	expressed as multiples of a single base tick, or would lead to
	a waste of high frequency periodic ticks. You can disable
	the periodic support for this architecture to save a few
	hundreds bytes if you plan to use the system timer in
	aperiodic mode only.

config XENO_HW_TIMER_LATENCY
	depends on XENO_OPT_EXPERT
	string "Timer tuning latency (ns)"
	default 0
	help
	This parameter accounts for the time (in nanoseconds) needed
	to program the underlying time source in one-shot timing mode.
	This value will be used to reduce the scheduling jitter induced
	by the time needed to setup the timer for its next shot. A
	default value of 0 (recommended) will cause this value to be
	estimated by the nucleus at startup.

config XENO_HW_SCHED_LATENCY
	depends on XENO_OPT_EXPERT
	string "Scheduling latency (ns)"
	default 0
	help
	Scheduling latency is the time between the termination of an
	interrupt handler and the execution of the first instruction
	of the real-time thread this handler resumes. A
	default value of 0 (recommended) will cause this value to be
	estimated by the nucleus at startup.

endmenu

source "skins/Kconfig"

menu "Drivers"

source "drivers/Kconfig"

endmenu

source "sim/Kconfig"
```

## drivers/16550A/Kconfig
```kconfig
config XENO_DRIVERS_16550A
	depends on XENO_SKIN_RTDM
	bool "16550A UART driver"
	default n
	help
	Real-time UART driver for 16550A compatible controllers.
```
