## ksrc/skins/Kconfig
```kconfig
menu "Interfaces"

depends on XENO_OPT_NUCLEUS

source "kernel/xenomai/skins/native/Kconfig"
source "kernel/xenomai/skins/posix/Kconfig"
source "kernel/xenomai/skins/rtdm/Kconfig"

endmenu
```

## ksrc/skins/comedi/Kconfig
```kconfig
menuconfig XENO_SKIN_COMEDI
	select XENO_SKIN_RTDM
	tristate "COMEDI interface"
	help

	COMEDI is a popular framework aimed at supporting data
	acquisition drivers (see http://comedi.org).

	This skin is a port of the original COMEDI framework over the
	RTDM interface.
```

## ksrc/skins/posix/Kconfig
```kconfig
config XENO_SKIN_POSIX
	depends on XENO_OPT_NUCLEUS
	tristate "POSIX API"
	default y
	help

	A POSIX-compliant skin.

if XENO_SKIN_POSIX != n

config XENO_OPT_POSIX_SHM
	bool "Shared memory"
	help

	POSIX skin shared memory areas are regions of memory which can be shared
	between kernel-space and user-space, or used to share synchronization
	objects between kernel-space and user-space.

	If you do not intend to use Xenomai POSIX skin in kernel-space (and
	using the RTDM skin is the preferred way of implementing drivers), leave
	this option unselected.

config XENO_OPT_POSIX_INTR
	bool "Interrupts"
	help

	This option provides an ad-hoc API to deal with interrupts in programs
	using Xenomai POSIX skin, both in kernel and user-space contexts. If you
	do not intend to handle interrupts in POSIX skin programs (and using the
	RTDM skin is the preferred way of implementing drivers), leave this
	option unselected.

config XENO_OPT_DEBUG_POSIX
	bool "Debugging support"
	default y
	help

	When enabled, this option makes the skin warn about not properly
	cleaned up POSIX objects it detects on process termination.

endif
```

## ksrc/skins/psos+/Kconfig
```kconfig
config XENO_SKIN_PSOS
	depends on XENO_OPT_NUCLEUS
	tristate "pSOS+ emulator"
	select XENO_OPT_REGISTRY if XENO_OPT_PERVASIVE
	default n
	help

	This API skin emulates WindRiver's pSOS+ operating system.
```
