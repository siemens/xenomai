## ksrc/drivers/benchmark/Kconfig
```kconfig
config XENO_DRIVERS_TIMERBENCH
	depends on XENO_SKIN_RTDM
	tristate "Timer benchmark driver"
	default n
	help
	Kernel-based benchmark driver for timer latency evaluation.
	See testsuite/latency for a possible front-end.
```

## ksrc/drivers/can/Config.in
```kconfig
#
# Xenomai configuration for Linux v2.4
#

mainmenu_option next_comment
comment 'CAN drivers'

dep_tristate 'RT-Socket-CAN, CAN raw socket interface' CONFIG_XENO_DRIVERS_RTCAN $CONFIG_XENO_SKIN_RTDM

if [ "$CONFIG_XENO_DRIVERS_RTCAN" != "n" ]; then 
   bool 'Enable debug output' CONFIG_XENO_DRIVERS_RTCAN_DEBUG
   int 'Size of receive ring buffers (must be 2^N)' CONFIG_XENO_DRIVERS_RTCAN_RXBUF_SIZE 1024
   int 'Maximum number of devices' CONFIG_XENO_DRIVERS_RTCAN_MAX_DEVICES 4
   int 'Maximum number of receive filters per device' CONFIG_XENO_DRIVERS_RTCAN_MAX_RECEIVERS 16

   dep_tristate 'Virtual tunnelling driver' CONFIG_XENO_DRIVERS_RTCAN_VIRT $CONFIG_XENO_DRIVERS_RTCAN

   source drivers/xenomai/can/mscan/Config.in
   source drivers/xenomai/can/sja1000/Config.in

fi

endmenu
```

## ksrc/drivers/can/Kconfig
```kconfig
menu "CAN drivers"

config XENO_DRIVERS_RTCAN
       depends on XENO_SKIN_RTDM
       tristate "RT-Socket-CAN, CAN raw socket interface"
       help
       RT-Socket-CAN is a real-time socket interface for CAN controllers.

config XENO_DRIVERS_RTCAN_DEBUG
       depends on XENO_DRIVERS_RTCAN
       bool "Enable debug output"
       default y

config XENO_DRIVERS_RTCAN_RXBUF_SIZE
       depends on XENO_DRIVERS_RTCAN
       int "Size of receive ring buffers (must be 2^N)"
       default 1024

config XENO_DRIVERS_RTCAN_MAX_DEVICES
       depends on XENO_DRIVERS_RTCAN
       int "Maximum number of devices"
       default 4

config XENO_DRIVERS_RTCAN_MAX_RECEIVERS
       depends on XENO_DRIVERS_RTCAN
       int "Maximum number of receive filters per device"
       default 16

config XENO_DRIVERS_RTCAN_VIRT
	depends on XENO_DRIVERS_RTCAN
	tristate "Virtual CAN bus driver"

source drivers/xenomai/can/mscan/Kconfig
source drivers/xenomai/can/sja1000/Kconfig

endmenu
```

## ksrc/drivers/can/mscan/Config.in
```kconfig
#
# Xenomai configuration for Linux v2.4
#

if [ "$CONFIG_MPC5200" = "y" ]; then

dep_tristate 'MSCAN driver for MPC5200' CONFIG_XENO_DRIVERS_RTCAN_MSCAN $CONFIG_XENO_DRIVERS_RTCAN

if [ "$CONFIG_XENO_DRIVERS_RTCAN_MSCAN" != "n" ]; then
    bool 'Enable CAN 1' CONFIG_XENO_DRIVERS_RTCAN_MSCAN_1
    bool 'Enable CAN 2' CONFIG_XENO_DRIVERS_RTCAN_MSCAN_2
    int 'Clock Frequency in Hz' CONFIG_XENO_DRIVERS_RTCAN_MSCAN_CLOCK 66000000
    choice 'Pin Configuration' \
    "I2C1/TMR01 CONFIG_XENO_DRIVERS_RTCAN_MSCAN_ALT \
     PSC2       CONFIG_XENO_DRIVERS_RTCAN_MSCAN_PSC2" I2C1/TMR01
fi

fi
```

## ksrc/drivers/can/mscan/Kconfig
```kconfig
config XENO_DRIVERS_RTCAN_MSCAN
       depends on XENO_DRIVERS_RTCAN && PPC_MPC52xx
       tristate "MSCAN driver for MPC52xx"
       default n
	
config XENO_DRIVERS_RTCAN_MSCAN_1
       depends on XENO_DRIVERS_RTCAN_MSCAN
       bool "Enable CAN 1"
       default y
	
config XENO_DRIVERS_RTCAN_MSCAN_2
       depends on XENO_DRIVERS_RTCAN_MSCAN
       bool "Enable CAN 2"
       default y
	
config XENO_DRIVERS_RTCAN_MSCAN_CLOCK
       depends on XENO_DRIVERS_RTCAN_MSCAN
       int "Clock Frequency in Hz"
       default 66000000        
       
choice
	depends on XENO_DRIVERS_RTCAN_MSCAN
	prompt "Pin Configuration"
	default I2C1/TMR01

config 	XENO_DRIVERS_RTCAN_MSCAN_ALT
	bool "CAN 1 on I2C1 pins, CAN 2 on TMR01 pins"

config 	XENO_DRIVERS_RTCAN_MSCAN_PSC2
	bool "CAN 1 and 2 on PSC2 pins"

endchoice
```

## ksrc/drivers/can/sja1000/Kconfig
```kconfig
config XENO_DRIVERS_RTCAN_SJA1000
	depends on XENO_DRIVERS_RTCAN
	tristate "Philips SJA1000 CAN controller"

config XENO_DRIVERS_RTCAN_SJA1000_ISA
	depends on XENO_DRIVERS_RTCAN_SJA1000
	tristate "Standard ISA controllers"

config XENO_DRIVERS_RTCAN_SJA1000_ISA_MAX_DEV
	depends on XENO_DRIVERS_RTCAN_SJA1000_ISA
	int "Maximum number of controllers"
	default 4

config XENO_DRIVERS_RTCAN_SJA1000_MEM
	depends on XENO_DRIVERS_RTCAN_SJA1000
	tristate "Memory mapped controllers"

config XENO_DRIVERS_RTCAN_SJA1000_MEM_MAX_DEV
	depends on XENO_DRIVERS_RTCAN_SJA1000_MEM
	int "Maximum number of controllers"
	default 4

config XENO_DRIVERS_RTCAN_SJA1000_PEAK_PCI
	depends on XENO_DRIVERS_RTCAN_SJA1000
	tristate "PEAK PCI Card"

config XENO_DRIVERS_RTCAN_SJA1000_PEAK_DNG
	depends on XENO_DRIVERS_RTCAN_SJA1000
	tristate "PEAK Parallel Port Dongle"
```

## ksrc/drivers/comedi/Config.in
```kconfig
#
# Xenomai configuration for Linux v2.4
#

mainmenu_option next_comment
comment 'COMEDI drivers'

dep_tristate 'COMEDI interface' CONFIG_XENO_DRIVERS_COMEDI $CONFIG_XENO_SKIN_RTDM

if [ "$CONFIG_XENO_DRIVERS_COMEDI" != "n" ]; then 
   source drivers/xenomai/comedi/testing/Config.in
fi

endmenu
```

## ksrc/drivers/comedi/Kconfig
```kconfig
menu "COMEDI drivers"

config XENO_DRIVERS_COMEDI
	depends on XENO_SKIN_RTDM
	tristate "COMEDI interface"
	help

	COMEDI is a popular framework aimed at supporting data
	acquisition drivers (see http://comedi.org).

	This driver stack is a port of the original COMEDI framework
	over the RTDM interface.

config XENO_DRIVERS_COMEDI_DEBUG
       bool "Comedi debug trace"
       default y
       help

       Enable debugging traces in Comedi so as to monitor Comedi's
       core and drivers behaviours.

config XENO_DRIVERS_COMEDI_DEBUG_LEVEL
       int "Comedi core debug level threshold"
       default 0
       help

       Define the level above which the debugging traces will not be
       displayed.

       WARNING: this threshold is only applied on the Comedi
       core. That will not affect the driver.

source drivers/xenomai/comedi/testing/Kconfig
source drivers/xenomai/comedi/intel/Kconfig
source drivers/xenomai/comedi/national_instruments/Kconfig

endmenu
```

## ksrc/drivers/comedi/testing/Kconfig
```kconfig
config XENO_DRIVERS_COMEDI_FAKE
	depends on XENO_DRIVERS_COMEDI
	tristate "Fake driver"
	default n

config XENO_DRIVERS_COMEDI_LOOP
	depends on XENO_DRIVERS_COMEDI
	tristate "Loop driver"
	default n
```

## ksrc/drivers/ipc/Kconfig
```kconfig
menu "Real-time IPC drivers"

config XENO_DRIVERS_RTIPC
	depends on XENO_SKIN_RTDM
	tristate "RTIPC protocol family"
	help

	This driver provides the real-time IPC protocol family
	(PF_RTIPC) over RTDM.

config XENO_DRIVERS_RTIPC_XDDP
	depends on XENO_DRIVERS_RTIPC
	select XENO_OPT_PIPE
	bool "XDDP cross-domain datagram protocol"
	help

	Xenomai's XDDP protocol enables threads to exchange datagrams
	across the Xenomai/Linux domain boundary, using "message
	pipes".

	Message pipes are bi-directional FIFO communication channels
	allowing data exchange between real-time Xenomai threads and
	regular (i.e. non real-time) user-space processes. Message
	pipes are datagram-based and thus natively preserve message
	boundaries, but they can also be used in byte stream mode when
	sending from the real-time to the non real-time domain.

	The maximum number of communication ports available in the
	system can be configured using the XENO_OPT_PIPE_NRDEV option
	from the Nucleus menu.

	NOTE: this protocol is a replacement for the legacy RT_PIPE
	interface still available from the native skin, but which is
	scheduled for removal in Xenomai 3.

config XENO_DRIVERS_RTIPC_IDDP
	depends on XENO_DRIVERS_RTIPC
	bool "IDDP intra-domain datagram protocol"
	help

	Xenomai's IDDP protocol enables real-time threads to exchange
	datagrams within the Xenomai domain.

config XENO_OPT_IDDP_NRPORT
	depends on XENO_DRIVERS_RTIPC_IDDP
	int "Number of communication ports"
	default 32
	help

	This parameter defines the number of IDDP ports available in
	the system for creating receiver endpoints. Port numbers range
	from 0 to CONFIG_XENO_OPT_IDDP_NRPORT - 1.

endmenu
```

## ksrc/drivers/serial/Kconfig
```kconfig
menu "Serial drivers"

config XENO_DRIVERS_16550A
	depends on XENO_SKIN_RTDM
	tristate "16550A UART driver"
	help
	Real-time UART driver for 16550A compatible controllers. See
	doc/txt/16550A-driver.txt for more details.

endmenu
```

## ksrc/drivers/testing/Kconfig
```kconfig
menu "Testing drivers"

config XENO_DRIVERS_TIMERBENCH
	depends on XENO_SKIN_RTDM
	tristate "Timer benchmark driver"
	default y
	help
	Kernel-based benchmark driver for timer latency evaluation.
	See testsuite/latency for a possible front-end.

config XENO_DRIVERS_KLATENCY
	depends on XENO_DRIVERS_TIMERBENCH && m
	tristate "Kernel-only latency measurement module"
	help
	Kernel module for kernel-only latency measurement.

config XENO_DRIVERS_IRQBENCH
	depends on XENO_SKIN_RTDM
	tristate "IRQ benchmark driver"
	help
	Loopback driver for IRQ latency evaluation over serial or parallel
	port links. Additionally requires user-space helper and a logging tool
	(see testsuite/irqbench).

config XENO_DRIVERS_SWITCHTEST
	depends on XENO_SKIN_RTDM
	tristate "Context switch unit testing driver"
	default y
	help
	Kernel-based driver for unit testing context switches and
	FPU switches.

config XENO_DRIVERS_RTDMTEST
	depends on XENO_SKIN_RTDM && m
	tristate "RTDM unit tests driver"
	help
	Kernel driver for performing RTDM unit tests.

endmenu
```

## ksrc/nucleus/Config.in
```kconfig
#
# Xenomai nucleus configuration for Linux v2.4
#

if [ "$CONFIG_XENOMAI" = "y" ]; then

dep_tristate 'Nucleus' CONFIG_XENO_OPT_NUCLEUS $CONFIG_XENOMAI

if [ "$CONFIG_XENO_OPT_NUCLEUS" != "n" ]; then
	if [ "$CONFIG_PROC_FS" != "n" ]; then
            define_bool CONFIG_XENO_OPT_VFILE y
	fi
	mainmenu_option next_comment
	comment 'Nucleus options'
	bool 'Pervasive real-time support in user-space' CONFIG_XENO_OPT_PERVASIVE
	if [ "$CONFIG_XENO_OPT_PERVASIVE" != "n" ]; then
		bool 'Priority coupling support' CONFIG_XENO_OPT_PRIOCPL
	fi
	bool 'Message pipes' CONFIG_XENO_OPT_PIPE
	if [ "$CONFIG_XENO_OPT_PIPE" != "n" ]; then
		int 'Number of pipe devices' CONFIG_XENO_OPT_PIPE_NRDEV 32
	fi
	if [ "$CONFIG_XENO_OPT_PERVASIVE" != "n" ]; then
		define_bool CONFIG_XENO_OPT_REGISTRY y
	else
		bool 'Registry support' CONFIG_XENO_OPT_REGISTRY
	fi
	if [ "$CONFIG_XENO_OPT_REGISTRY" != "n" ]; then
		int 'Number of registry slots' CONFIG_XENO_OPT_REGISTRY_NRSLOTS 512
	fi
	int 'Size of the system heap (Kb)' CONFIG_XENO_OPT_SYS_HEAPSZ 128
 	if [ "$CONFIG_XENO_GENERIC_STACKPOOL" != "n" ]; then
 	   int 'Size of the private stack pool (Kb)' CONFIG_XENO_OPT_SYS_STACKPOOLSZ 32
 	fi
	bool 'Optimize as pipeline head' CONFIG_XENO_OPT_PIPELINE_HEAD
	bool 'Extra scheduling classes' CONFIG_XENO_OPT_SCHED_CLASSES
	if [ "$CONFIG_XENO_OPT_SCHED_CLASSES" = "y" ]; then
		bool 'Temporal partitioning' CONFIG_XENO_OPT_SCHED_TP
		if [ "$CONFIG_XENO_OPT_SCHED_TP" = "y" ]; then
		   int 'Number of partitions' CONFIG_XENO_OPT_SCHED_TP_NRPART 4
		fi
		bool 'Sporadic scheduling' CONFIG_XENO_OPT_SCHED_SPORADIC
		if [ "$CONFIG_XENO_OPT_SCHED_SPORADIC" = "y" ]; then
		   int 'Maximum number of pending replenishments' CONFIG_XENO_OPT_SCHED_SPORADIC_MAXREPL 8
		fi
	fi
	dep_bool 'Statistics collection' CONFIG_XENO_OPT_STATS $CONFIG_XENO_OPT_VFILE
	int 'Size of private semaphores heap (Kb)' CONFIG_XENO_OPT_SEM_HEAPSZ 12
	int 'Size of global semaphores heap (Kb)' CONFIG_XENO_OPT_GLOBAL_SEM_HEAPSZ 12
	bool 'Debug support' CONFIG_XENO_OPT_DEBUG
	if [ "$CONFIG_XENO_OPT_DEBUG" = "y" ]; then
		bool 'Nucleus Debugging support' CONFIG_XENO_OPT_DEBUG_NUCLEUS
		bool 'Queue Debugging support' CONFIG_XENO_OPT_DEBUG_QUEUES
		if [ "$CONFIG_XENO_OPT_PERVASIVE" != "n" ]; then
		  bool 'Detect mutexes held in relaxed sections' CONFIG_XENO_OPT_DEBUG_SYNCH_RELAX
		fi
		bool 'Watchdog support' CONFIG_XENO_OPT_WATCHDOG
		if [ "$CONFIG_XENO_OPT_WATCHDOG" = "y" ]; then
			int 'Watchdog timeout (seconds)' CONFIG_XENO_OPT_WATCHDOG_TIMEOUT 4
		fi
	fi

	bool 'Shared interrupts' CONFIG_XENO_OPT_SHIRQ
	bool 'Core support for select-like services' CONFIG_XENO_OPT_SELECT

	bool 'Enable periodic timing' CONFIG_XENO_OPT_TIMING_PERIODIC
	int "Virtual tick duration in aperiodic mode (us)" CONFIG_XENO_OPT_TIMING_VIRTICK 1000
	int 'Timer tuning latency (ns)' CONFIG_XENO_OPT_TIMING_TIMERLAT 0
	int 'Scheduling latency (ns)' CONFIG_XENO_OPT_TIMING_SCHEDLAT 0

	mainmenu_option next_comment
	comment 'Scalability options'
		bool 'O(1) scheduler' CONFIG_XENO_OPT_SCALABLE_SCHED
        choice 'Timer indexing method'			\
	"Linear			CONFIG_XENO_OPT_TIMER_LIST	\
	 Tree			CONFIG_XENO_OPT_TIMER_HEAP	\
	 Hash			CONFIG_XENO_OPT_TIMER_WHEEL"	Linear
	if [ "$CONFIG_XENO_OPT_TIMER_HEAP" = "y" ]; then
		int 'Max. number of timers' CONFIG_XENO_OPT_TIMER_HEAP_CAPACITY 256
	fi
	if [ "$CONFIG_XENO_OPT_TIMER_WHEEL" = "y" ]; then
		int 'Timer wheel step (ns)' CONFIG_XENO_OPT_TIMER_WHEEL_STEP 100000
	fi
	endmenu

	endmenu
fi

fi
```
