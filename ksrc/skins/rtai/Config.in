## ksrc/skins/rtai/Kconfig
```kconfig
menuconfig XENO_SKIN_RTAI
	depends on XENO_OPT_NUCLEUS && MMU && WORD_SIZE != 64
	tristate "RTAI emulator (BROKEN, DEPRECATED)"
	help

	An emulator of the RTAI system.

	This emulator is actually broken beyond all recognition:
	- on MMU-less targets
	- on 64bit targets

	WARNING: This emulator is DEPRECATED. It is planned for
	removal in v2.6.x. Legacy applications depending on it should
	be converted to the native Xenomai API, which provides
	equivalent features, and more.

if XENO_SKIN_RTAI

config XENO_OPT_RTAI_PERIOD
	int "Base period (us)" if XENO_OPT_TIMING_PERIODIC
	default 0
	help
	Duration of the base periodic tick (in microseconds).

	The RTAI skin can express all delays and timeouts either as
	counts of ticks (i.e. jiffy-based), or directly in
	nanoseconds in a tick-less fashion. This paramater defines the
	duration of the base period in microseconds; a null value
	selects the tick-less mode.

	The base period can be overriden at runtime using the
	"tick_arg" module parameter when loading the RTAI skin.

	If in doubt, leave zero in this field.

config XENO_OPT_RTAI_FIFO
	bool "Fifos"
	select XENO_OPT_PIPE
	default y
	help

	Fifos are uni-directional communication channels allowing data
	exchange between real-time tasks in kernel-space and regular
	user-space processes.

config XENO_OPT_RTAI_SEM
	bool "Semaphores"
	default y
	help

	Semaphores are synchronization objects granting RTAI
	tasks a concurrent access to a given number of resources.

config XENO_OPT_RTAI_SHM
	bool "Shared Memory"
	default y
	help

	SHM are Shared Memory objects across RTAI tasks.

endif
```

## ksrc/skins/rtdm/Kconfig
```kconfig
config XENO_SKIN_RTDM
	depends on XENO_OPT_NUCLEUS
	tristate "Real-Time Driver Model"
	default y
	help

	This API skin allows to write real-time drivers against a common
	light weight interface in kernel mode, but use them across all other
	skins in both kernel and user mode.

config XENO_OPT_RTDM_FILDES
	int "Maximum number of RTDM file descriptors"
	depends on XENO_SKIN_RTDM
	default 128
	help

	This option defines the maximum number of RTDM file descriptors
	which can be opened at the same time. RTDM file descriptors are
	a global resource all applications share, either via the RTDM skin
	directly or via the embedded services of the POSIX skin.

config XENO_OPT_DEBUG_RTDM
	bool "RTDM debugging support"
	depends on XENO_OPT_DEBUG && XENO_SKIN_RTDM
	help

	This option activates debugging checks for the RTDM subsystem.
	It is a recommended option for analysing potential issues in RTDM
	drivers. A minor runtime overhead is added.
```

## ksrc/skins/uitron/Kconfig
```kconfig
config XENO_SKIN_UITRON
	depends on XENO_OPT_NUCLEUS
	tristate "uITRON API"
	default n
	help

	This API skin emulates the uITRON API. 
```

## ksrc/skins/uvm/Kconfig
```kconfig
config XENO_SKIN_UVM
	depends on XENO_OPT_NUCLEUS && XENO_OPT_PERVASIVE
	tristate "User-space VM support (DEPRECATED)"
	default n
	help

	This feature provides support for running applications based
	on legacy RTOS APIs inside virtual machines in user-space
	with hard real-time capabilities. The application and the RTOS
	will be self-contained and sandboxed in a single regular Linux
	process.

	This feature is deprecated, and will be removed from the next
	major Xenomai release. Applications should rather use
	the system call interface library available with the
	real-time skin of interest (e.g. link against libvxworks.so
	instead of libvxworks_uvm.so), which directly invokes
	real-time services implemented by the skin module, on behalf
	of the Linux process.
```

## ksrc/skins/vrtx/Kconfig
```kconfig
config XENO_SKIN_VRTX
	depends on XENO_OPT_NUCLEUS
	tristate "VRTX emulator"
	select XENO_OPT_REGISTRY if XENO_OPT_PERVASIVE
	help

	This API skin emulates Mentor Graphics's VRTX operating
	system.
```

## ksrc/skins/vxworks/Kconfig
```kconfig
config XENO_SKIN_VXWORKS
	depends on XENO_OPT_NUCLEUS
	tristate "VxWorks emulator"
	select XENO_OPT_REGISTRY if XENO_OPT_PERVASIVE
	help

	This API skin emulates WindRiver's VxWorks operating system.
```

## nucleus/Kconfig
```kconfig
menu "Nucleus"

config XENO_OPT_PERVASIVE
	bool "Pervasive real-time support in user-space"
	default y
	help

	Enable pervasive real-time support for user-space Linux
	processes, which is the default operating mode for
	Xenomai. Switching this option out only leaves the
	minimal support needed for running in-kernel
	applications, which directly call the real-time APIs from
	kernel modules.

config XENO_OPT_PIPE
	bool "Message pipes"
	default y
	help

	Message pipes are bi-directional FIFO communication
	channels allowing data exchange between real-time kernel
	threads and regular user-space processes. Pipes natively
	preserve message boundaries, but can also be used in byte
	streaming mode from kernel to user-space.

config XENO_OPT_PIPE_NRDEV
	string "Number of pipe devices"
	depends on XENO_OPT_PIPE
	default 32
	help
	
	This option sets the maximum number of pipe devices supported
	in the system. Pipe devices are named /dev/rtpN where N is a
	device minor number ranging from 0 to XENO_OPT_PIPE_NRDEV - 1.

config XENO_OPT_SYS_HEAPSZ
	string "Size of the system heap (Kb)"
	default 128
	help

	The system heap is used for various internal allocations by
	the nucleus and the real-time skins. The size is expressed in
	Kilobytes.

config XENO_OPT_ISHIELD
	bool "Interrupt shield support"
	depends on XENO_OPT_EXPERT && XENO_OPT_PERVASIVE
	default n
	help
	
	This option builds in the interrupt shield support, which can
	be further enabled on a thread-by-thread basis. When enabled
	for a thread, the interrupt shield prevents it from being
	preempted by Linux interrupt handlers when it executes in the
	secondary domain (i.e. under the control of the Linux
	scheduler), thus increasing the execution time accuracy for
	CPU-bound tasks.

	Note: since the interrupt shield adds extra-computation to the
	critical path, applications based on threads running in the
	primary Xenomai domain, hence for which preemption by any kind
	of Linux kernel activities is already prevented by design,
	should leave this option disabled.

config XENO_OPT_STATS
	bool "Statistics collection"
	depends on XENO_OPT_EXPERT
	default y
	help
	
	This option causes the real-time nucleus to collect various
	per-thread runtime statistics, which are accessible through
	the /proc/xenomai/stats interface.

config XENO_OPT_DEBUG
	bool "Debug support"
	depends on XENO_OPT_EXPERT
	default n
	help
	
	This option activates various debugging checks inside the core
	system. Doing so adds a significant runtime overhead,
	worsening the latency figures especially on SMP kernels.
	Do not switch this option on unless you really know what you
	are doing.

config XENO_OPT_WATCHDOG
	bool "Watchdog support"
	depends on XENO_OPT_EXPERT
	default n
	help
	
	This option activates a watchdog aimed at detecting runaway
	real-time threads. If enabled, the watchdog triggers after 4
	seconds of uninterrupted real-time activity without Linux
	interaction; in such event, the current real-time thread is
	forcibly suspended. The built-in watchdog support operates on
	behalf of the timer tick handler, thus is only active after
	the timer has been started.

config XENO_OPT_CONFIG_GZ
	bool "Wrapped configuration file"
	depends on XENO_OPT_EXPERT
	default n
	help
	
	This option enables the complete Xenomai ".xeno_config"
	file contents to be saved in the nucleus. It provides
	documentation of which options are used in a running system or
	in an on-disk nucleus image.  This information can be
	extracted from the nucleus image file with the regular Linux
	kernel script "scripts/extract-ikconfig" and used as input to
	rebuild the current Xenomai system or to build another
	system.  It can also be extracted from a running system by
	reading /proc/xenomai/config.gz if enabled.

menu "Scalability"
	depends on XENO_OPT_EXPERT

config XENO_OPT_SCALABLE_SCHED
	bool "O(1) scheduler"
	default n
	help
	
	This option causes a multi-level priority queue to be
	used in the real-time thread scheduler, so that it operates
	in constant-time regardless of the number of _concurrently
	runnable_ threads (which might be much lower than the total
	number of active threads). Its use is recommended for
	large multi-threaded systems involving more than 10 of such
	threads; otherwise, the default linear method usually performs
	better with lower memory footprints.

config XENO_OPT_SCALABLE_PRIOS
	string "Number of priority levels"
	depends on XENO_OPT_SCALABLE_SCHED
	default 256
	help

	This option sets the maximum number of priority levels available
	within the scalable scheduler's multi-level queue. This value
	must be higher or equal than the maximum priority range which
	could be required for running the real-time skin used by the
	application. For instance, the native skin needs a
	hundred priority levels.

endmenu

menu "LTT tracepoints filtering"
	depends on XENO_OPT_EXPERT

config XENO_OPT_FILTER_EVIRQ
	bool "Disable IRQ-related tracepoints"
	default y if XENO_OPT_FILTER_EVALL=y
	help
	
	When LTT support is active, this option disables tracepoints
	inside real-time interrupt handlers.

config XENO_OPT_FILTER_EVTHR
	bool "Disable thread-related tracepoints"
	default y if XENO_OPT_FILTER_EVALL=y
	help
	
	When LTT support is active, this option disables tracepoints
	inside most thread-related services.

config XENO_OPT_FILTER_EVSYS
	bool "Disable syscall-related tracepoints"
	default y if XENO_OPT_FILTER_EVALL=y
	help
	
	When LTT support is active, this option disables tracepoints
	inside the shadow syscall dispatcher.

config XENO_OPT_FILTER_EVALL
	bool "Disable all tracepoints"
	default n
	help
	
	This option disables all LTT tracepoints inside Xenomai.

endmenu

endmenu
```

## sim/Kconfig
```kconfig
menu "Simulator"

config XENO_MVM
	bool "Minute Virtual Machine"
	default n
	help

	Xenomai includes an event-driven simulator dubbed "the
	Minute Virtual Machine" (MVM).

	Using the MVM to run your real-time applications has a lot of
	advantages: it is faster, it does not require
	cross-development tools, gives extended debugging, monitoring
	and tracing features and provides an easy way to stress the
	application under test with run-time situations otherwise
	barely conceivable on a real target (e.g. bursts of simulated
	interrupts generated at a very unreasonable rate!).

	The application shall not contain target-dependent code, such
	as assembly code, because it runs as a regular executable
	compiled by GCC on a GNU/Linux workstation. It cannot be
	possible to use the MVM to collect accurate performance
	footprints of your system, but it may show you precisely how
	the multiple threads running in your system work together
	sharing the resources of the real-time interface.

config XENO_MVM_GCC_TARBALL
	string "GCC tarball"
	depends on XENO_MVM
	default "/tmp/gcc-2.95.3.tar.bz2"
	help
	
	In order to be able to instrument your code and debug it using
	the Minute Virtual Machine (MVM), you need a special compiler
	called gcic. This particular tool is based on a patched gcc
	whose archive directory has to be specified here.
	The default value is /tmp/gcc-2.95.3.tar.bz2.

config XENO_MVM_DEBUG
	bool "MVM debug support"
	depends on XENO_MVM && XENO_OPT_EXPERT
	default n
	help
	
	This option activates runtime checking of the event-driven
	simulator state. Do not activate it unless you really intend
	to debug the Minute Virtual Machine.

config XENO_MVM_ATOMIC_CORE
	bool "Disable core instrumentation"
	depends on XENO_MVM && XENO_OPT_EXPERT
	default n
	help
	
	This option suppresses the instrumentation of the nucleus and
	skin sources so that the resulting simulation is suitable for
	performance analysis through the Valgrind/Cachegrind/Callgrind
	toolsuite. Enabling this option prevents those portions of
	code from being debugged interactively using the Xenoscope
	though.

config XENO_HW_PERIODIC_TIMER
	bool
	default y

endmenu
```

## skins/Kconfig
```kconfig
menu "APIs"

source "skins/native/Kconfig"

source "skins/posix/Kconfig"

source "skins/psos+/Kconfig"

source "skins/uitron/Kconfig"

source "skins/vrtx/Kconfig"

source "skins/vxworks/Kconfig"

source "skins/rtdm/Kconfig"

source "skins/rtai/Kconfig"

config XENO_OPT_UVM
	bool "User-space VM support"
	depends on XENO_OPT_PERVASIVE
	default n
	help

	This feature allows applications based on legacy RTOS
	APIs to run inside virtual machines in user-space
	with hard real-time capabilities.
	If activated, this option will cause in-kernel emulators
	which have been selected in the current menu to be
	compiled as process-embeddable virtual machines.

endmenu
```

## skins/posix/Kconfig
```kconfig
config XENO_SKIN_POSIX
	bool "POSIX API"
	default n
	help

	A POSIX-compliant skin in kernel space.
```

## skins/psos+/Kconfig
```kconfig
config XENO_SKIN_PSOS
	bool "pSOS+ emulator"
	default n
	help

	This API skin emulates WindRiver's pSOS+ operating system.
```

## skins/rtai/Kconfig
```kconfig
config XENO_SKIN_RTAI
	bool "RTAI emulator"
	default n
	help

	An emulator of the RTAI system.

config XENO_OPT_RTAI_FIFO
	bool "Fifos"
	depends on XENO_OPT_PIPE && XENO_SKIN_COMPAT
	default y
	help
	
	Fifos are uni-directional communication channels allowing data
	exchange between real-time tasks in kernel-space and regular
	user-space processes.

config XENO_OPT_RTAI_SEM
	bool "Semaphores"
	depends on XENO_SKIN_COMPAT
	default y
	help
	
	Semaphores are synchronization objects granting RTAI
	tasks a concurrent access to a given number of resources.

config XENO_OPT_RTAI_SHM
	bool "Shared Memory"
	depends on XENO_SKIN_COMPAT
	default y
	help
	
	SHM are Shared Memory objects across RTAI tasks.
```

## skins/rtdm/Kconfig
```kconfig
config XENO_SKIN_RTDM
	bool "Real-Time Driver Model"
	default y
	help

	This API skin allows to write real-time drivers against a common
	light weight interface in kernel mode, but use them across all other
	skins in both kernel and user mode.
```

## skins/uitron/Kconfig
```kconfig
config XENO_SKIN_UITRON
	bool "uITRON API"
	default n
	help

	This API skin emulates the uITRON API. 
```

## skins/vrtx/Kconfig
```kconfig
config XENO_SKIN_VRTX
	bool "VRTX emulator"
	default n
	help

	This API skin emulates Mentor Graphics's VRTX operating
	system.
```

## skins/vxworks/Kconfig
```kconfig
config XENO_SKIN_VXWORKS
	bool "VxWorks emulator"
	default n
	help

	This API skin emulates WindRiver's VxWorks operating system.
```
